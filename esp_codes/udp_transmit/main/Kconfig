## esp_codes/udp_transmit/main/Kconfig
```kconfig
menu "IP address and port configuration"

    config UDP_IP_ADDRESS
        string "UDP IP ADDRESS"
        default "192.168.0.126"
        help 
            "IP Address of the udp server"
    
    config UDP_PORT
        int "UDP PORT"
        default 1212
        help
            "Port of the udp server"
    
    config TCP_IP_ADDRESS
        string "TCP IP ADDRESS"
        default "192.168.0.126"
        help 
            "IP Address of the tcp command server"
    
    config TCP_PORT
        int "TCP PORT"
        default 2121
        help 
            "Port of the tcp command server"        
endmenu

menu "Message queue size configuration"

    config MESSAGE_QUEUE_SIZE
        int "Message queue size"
        default 1000
        help 
            "Sets the size of message queue, set with caution, might cause buffer overflow for a higher value"
endmenu
```
